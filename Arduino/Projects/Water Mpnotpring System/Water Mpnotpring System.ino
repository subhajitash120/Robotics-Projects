#define BLYNK_PRINT Serial

#define RELAY_PIN 16
#define soilMoisturePin 14
#define TDS_SENSOR_PIN A0
#define ONE_WIRE_BUS 2

#define BLYNK_TEMPLATE_ID "TMPL3PlhaeVJu"
#define BLYNK_TEMPLATE_NAME "Template 1"
#define BLYNK_AUTH_TOKEN "t5KI_6cEsDaz78Nz6-Ptd2jsSqW2d6Yy"

char ssid[] = "Cookie";
char pass[] = "123456780";

#include <ESP8266WiFi.h>
#include <BlynkSimpleEsp8266.h>
#include <OneWire.h>
#include <DallasTemperature.h>
#include <Wire.h>
#include <Adafruit_GFX.h>
#include <Adafruit_SSD1306.h>

float temperatureCompensatedTDS;

#define SCREEN_WIDTH 128
#define SCREEN_HEIGHT 64
#define OLED_RESET -1
Adafruit_SSD1306 display(SCREEN_WIDTH, SCREEN_HEIGHT, &Wire, OLED_RESET);

OneWire oneWire(ONE_WIRE_BUS);
DallasTemperature sensors(&oneWire);

const unsigned char epd_bitmap_images__1_ [] PROGMEM = {
  0x00, 0x00, 0x00, 0x00, 0x00, 0x00, 0x00, 0x01, 0x00, 0x01, 0x00, 0x00, 0x00, 0x00, 0x00, 0x00, 
	0x00, 0x00, 0x00, 0x00, 0x00, 0x03, 0x00, 0x02, 0x80, 0x02, 0x40, 0x00, 0x00, 0x00, 0x00, 0x00, 
	0x00, 0x00, 0x00, 0x00, 0x00, 0x04, 0xc0, 0x08, 0x20, 0x08, 0x20, 0x00, 0x00, 0x00, 0x00, 0x00, 
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	0x00, 0x00, 0x00, 0x01, 0xff, 0x00, 0x00, 0x00, 0x00, 0x00, 0x00, 0x7f, 0xc0, 0x00, 0x00, 0x00
};

const int epd_bitmap_allArray_LEN = 1;
const unsigned char* epd_bitmap_allArray[1] = {
    epd_bitmap_images__1_
};

void setup() {
  Serial.begin(9600);
  pinMode(RELAY_PIN, OUTPUT);
  Blynk.begin(BLYNK_AUTH_TOKEN, ssid, pass);

  if (!display.begin(SSD1306_SWITCHCAPVCC, 0x3C)) {
    Serial.println(F("SSD1306 allocation failed"));
    for(;;);
  }

  display.clearDisplay();
  display.drawBitmap(0, 0, epd_bitmap_images__1_, SCREEN_WIDTH, SCREEN_HEIGHT, WHITE);
  display.display();
  delay(7500);
}

void loop() {
  Blynk.run();
  int soilMoistureValue = digitalRead(soilMoisturePin);
  int relayStatus = digitalRead(RELAY_PIN);
  sensors.requestTemperatures();
  float tempC = sensors.getTempCByIndex(0);

  if (tempC != DEVICE_DISCONNECTED_C) {
    int tdsSensorValue = analogRead(TDS_SENSOR_PIN);
    temperatureCompensatedTDS = tdsSensorValue + getTDSCorrection(tempC);
    Blynk.virtualWrite(V2, tempC);
    Blynk.virtualWrite(V3, temperatureCompensatedTDS);
    Serial.print("Water Temperature: ");
    Serial.print(tempC);
    Serial.println(" C");
    Serial.print("TDS Value: ");
    Serial.println(temperatureCompensatedTDS);
  } else {
    Serial.println("Error: Could not read temperature data");
  }

  if (soilMoistureValue == HIGH) {
    Serial.println("Tank is Empty");
    soilMoistureValue = 0;
  } else {
    Serial.println("Tank is Full");
    soilMoistureValue = 1;
  }

  Blynk.virtualWrite(V1, soilMoistureValue);

  if (relayStatus == HIGH) {
    Serial.println("Tap is ON");
  } else {
    Serial.println("Tap is OFF");
  }

  Serial.println();
  display.clearDisplay();
  display.setTextSize(1);
  display.setTextColor(SSD1306_WHITE);
  display.setCursor(0, 0);
  display.print("Temperature: ");
  display.print(tempC);
  display.print(" C");
  display.setCursor(0, 10);
  display.print("TDS Value: ");
  display.print(temperatureCompensatedTDS);
  display.setCursor(0, 30);
  display.print("Tank Status: ");
  display.print((soilMoistureValue == 1) ? "Full" : "Empty");
  display.setCursor(0, 40);
  display.print("Tap Status: ");
  display.print((relayStatus == HIGH) ? "ON" : "OFF");
  display.display();
  delay(1000);
}

BLYNK_WRITE(V0) {
  int pinValue = param.asInt();
  if (pinValue == 1) {
    digitalWrite(RELAY_PIN, HIGH);
  } else {
    digitalWrite(RELAY_PIN, LOW);
  }
}

float getTDSCorrection(float temperatureC) {
  float temperatureCorrection = 1 * temperatureC;
  return temperatureCorrection;
}
